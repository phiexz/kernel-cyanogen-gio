## drivers/gpuoc/Kconfig
```kconfig
#
# TASS module configuration
#

config Tass_GPU_OVERCLOCK
	tristate "TASS GPU Overclock"
	help
	  Say Y here if you want to build an overclock module for Tass

	  If unsure, say N.

	  To compile this module, choose M here: the
	  module will be called gpuoc.ko.
```

## drivers/uv/Kconfig
```kconfig
#
# tassuv module configuration
#

config Tass_UNDERVOLT
	tristate "Tass undervolt"
	help
	  Say Y here if you want to build an undervolt module for Tass

	  If unsure, say N.

	  To compile this module, choose M here: the
	  module will be called tassuv.
```
